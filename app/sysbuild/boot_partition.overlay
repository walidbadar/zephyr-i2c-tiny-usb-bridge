/*
 * SPDX-FileCopyrightText: 2026 Muhammad Waleed Badar
 *
 * SPDX-License-Identifier: Apache-2.0
 */

/* MCUboot runs from the boot partition of the board overlay's flash layout */
/ {
	chosen {
		zephyr,code-partition = &boot_partition;
	};
};
