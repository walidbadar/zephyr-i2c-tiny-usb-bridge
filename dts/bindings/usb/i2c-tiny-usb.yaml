## dts/bindings/usb/i2c-tiny-usb.yaml
```yaml
# SPDX-FileCopyrightText: 2026 Muhammad Waleed Badar
# SPDX-License-Identifier: Apache-2.0

description: |
  USB to I2C bridge

  Bridges an I2C controller to the host through the USB i2c-tiny-usb class.
  Only one instance is supported.

compatible: "i2c-tiny-usb"

include: base.yaml

properties:
  i2c-bus:
    type: phandle
    description: |
      I2C controller to bridge, either a hardware controller or a gpio-i2c
      node for a bit-banged bus. Defaults to the zephyr_i2c node label when
      present.

  activity-led:
    type: phandle
    description: |
      LED, as a child of an LED controller node such as gpio-leds, that is on
      while the host has configured the device and goes off briefly for each
      I2C transaction. Defaults to the led0 alias when present.

examples: |
    / {
            i2c_tiny_usb0: i2c-tiny-usb {
                    compatible = "i2c-tiny-usb";
                    i2c-bus = <&i2c1>;
                    activity-led = <&green_led>;
            };
    };
```

## subsys/usb/class/Kconfig
```kconfig
# SPDX-FileCopyrightText: 2026 Muhammad Waleed Badar
# SPDX-License-Identifier: Apache-2.0

config USBD_I2C_TINY_USB_CLASS
	bool "USB i2c-tiny-usb class"
	depends on USB_DEVICE_STACK_NEXT
	depends on I2C
	depends on DT_HAS_I2C_TINY_USB_ENABLED
	select USBD_VREQ_SUPPORT
	default y
	help
	  USB device class compatible with the i2c-tiny-usb adapter. It bridges
	  the I2C controller of the i2c-tiny-usb devicetree node to the Linux
	  i2c-tiny-usb driver.

# Selecting LED would create a dependency loop through LED drivers that
# select I2C, so the activity LED gets a default instead
configdefault LED
	default y if $(dt_compat_enabled,i2c-tiny-usb) && \
		     ($(dt_compat_any_has_prop,i2c-tiny-usb,activity-led) || \
		      $(dt_alias_enabled,led0))

if USBD_I2C_TINY_USB_CLASS

config USBD_I2C_TINY_USB_LED
	bool "Activity LED"
	default y
	depends on LED
	depends on $(dt_compat_any_has_prop,i2c-tiny-usb,activity-led) || \
		   $(dt_alias_enabled,led0)
	help
	  Drive the activity-led of the i2c-tiny-usb devicetree node, or the
	  led0 alias. The LED is on while the host has configured the device
	  and goes off briefly for each I2C transaction.

config USBD_I2C_TINY_USB_LED_BLINK_MS
	int "Activity LED off time"
	default 20
	range 1 1000
	depends on USBD_I2C_TINY_USB_LED
	help
	  Time in milliseconds the LED stays off after an I2C transaction.

module = USBD_I2C_TINY_USB
module-str = usbd i2c-tiny-usb
source "subsys/logging/Kconfig.template.log_config"

endif
```

## west.yml
```yaml
# SPDX-FileCopyrightText: 2026 Muhammad Waleed Badar
# SPDX-License-Identifier: Apache-2.0

manifest:
  self:
    path: zephyr-i2c-tiny-usb-bridge

  remotes:
    - name: zephyrproject-rtos
      url-base: https://github.com/zephyrproject-rtos

  projects:
    - name: zephyr
      remote: zephyrproject-rtos
      revision: 2a9e8ac155a3f2fd85d4559753be86a47b44ccf0
      import:
        name-allowlist:
          - cmsis_6
          - hal_adi
          - hal_ambiq
          - hal_atmel
          - hal_bouffalolab
          - hal_espressif
          - hal_microchip
          - hal_nordic
          - hal_nuvoton
          - hal_nxp
          - hal_renesas
          - hal_rpi_pico
          - hal_stm32
          - mbedtls
          - mcuboot
          - segger
          - tf-psa-crypto
```
